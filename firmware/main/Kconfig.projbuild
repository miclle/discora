## firmware/main/Kconfig.projbuild
```kconfig
menu "Discora eject button"

config DISCORA_EJECT_BUTTON
    bool "Enable active-low eject button on GPIO7"
    depends on !DISCORA_AUDIO_DIAGNOSTIC && !DISCORA_CDDA_PROBE
    default y
    help
        Wire a normally-open momentary switch between GPIO7 and GND.
        Internal pull-up, 30 ms debounce, one request per press after release.
        Available in query and CD player modes; disabled in bounded bench modes.
        Only an identified, healthy optical drive accepts requests. No auto-eject.

endmenu

menu "Discora bench probes"

config DISCORA_CDDA_PROBE
    bool "Run one bounded READ CD probe per MCU boot"
    depends on !DISCORA_AUDIO_DIAGNOSTIC && !DISCORA_CD_PLAYER
    default n
    help
        Experimental, read-only CD-DA probe: requires a validated audio TOC.
        Reads 1 sector, 8 sectors twice, then at most 32 batches of 8 sectors.
        A reconnect or medium-state change does not re-arm the probe.
        Leave disabled until the bridge and power path have been checked.
        No audio bytes are logged or written to flash.

config DISCORA_CDDA_SOAK
    bool "Run seek, full-track and paced-buffer tests after the short probe"
    depends on DISCORA_CDDA_PROBE
    default n
    help
        One bounded run per MCU boot. Read recovery is separately opt-in.
        Uses real CD data and a software clocked discard sink, not I2S playback.

config DISCORA_SENSE_DATA_TIMEOUT_MS
    int "Diagnostic REQUEST SENSE data-stage timeout (ms)"
    depends on DISCORA_CDDA_PROBE || DISCORA_CD_PLAYER
    range 3000 30000
    default 3000
    help
        Changes only REQUEST SENSE Bulk IN data waiting. CBW, CSW and control
        transfers keep their normal deadline. No command replay is added.

config DISCORA_CDDA_SEEK_BENCH
    bool "Include the 12-position seek experiment"
    depends on DISCORA_CDDA_SOAK
    default y
    help
        Disable to isolate full-track and paced-buffer tests after a seek fault.
        A run with this disabled does not qualify seek behavior.

config DISCORA_CDDA_SEEK_WAIT_MS
    int "Quiet wait before each seek position (ms)"
    depends on DISCORA_CDDA_SEEK_BENCH
    range 0 3000
    default 0

config DISCORA_CDDA_SEEK_ROUNDS
    int "Number of 12-position seek rounds"
    depends on DISCORA_CDDA_SEEK_BENCH
    range 1 20
    default 1
    help
        Stop at the first unrecovered error. Recovery budget is per boot,
        never per round. A 600 s soft deadline is checked between positions;
        an in-flight command completes or reaches its normal timeout first.

config DISCORA_CDDA_SEEK_ONLY
    bool "Stop the extended workload after seeks (no full track or buffer)"
    depends on DISCORA_CDDA_SEEK_BENCH
    default n

config DISCORA_CDDA_SEEK_VARY_OFFSET
    bool "Vary track-relative offsets after the first seek round"
    depends on DISCORA_CDDA_SEEK_BENCH
    default n
    help
        Add 997 sectors per round modulo the valid eight-sector start range.
        Deterministic workload expansion, not a guarantee of cache bypass.

config DISCORA_CDDA_SEEK_RECOVERY
    bool "Allow one read recovery per boot for valid sense 03/02/00"
    depends on DISCORA_CDDA_PROBE || DISCORA_CD_PLAYER
    default n
    help
        Reserve one recovery, wait 1000 ms while servicing USB, require TUR
        success, then replay the identical read once. Never replay after
        disconnect, transport fault, missing sense or medium change.
        Preserve the original failure and report recovered reads separately.

config DISCORA_CDDA_FULL_TRACK_BENCH
    bool "Include a complete first-track read from INDEX 01"
    depends on DISCORA_CDDA_SOAK && !DISCORA_CDDA_SEEK_ONLY
    default y
    help
        Disable this and seeks to hand off sequentially from the short probe
        into the paced-buffer phase, without seeking back to an earlier LBA.

config DISCORA_CDDA_UNDERRUN_TEST
    bool "Negative control: pause producer to force a clock-sink underrun"
    depends on DISCORA_CDDA_SOAK && !DISCORA_CDDA_SEEK_BENCH && !DISCORA_CDDA_FULL_TRACK_BENCH
    default n
    help
        After two seconds, pause only the producer for 1200 ms. The normal
        buffer test must fail with one genuine underrun, stop and release
        the ring. A negative-control PASS is not a streaming PASS.

config DISCORA_CDDA_SOAK_SECONDS
    int "Paced-buffer test duration in seconds"
    depends on DISCORA_CDDA_SOAK
    range 60 1800
    default 600

endmenu

menu "Discora CD player"

config DISCORA_CD_PLAYER
    bool "Enable UART-controlled CD player (boot stopped)"
    depends on !DISCORA_AUDIO_DIAGNOSTIC
    default n
    help
        Real READ CD producer with independent output/control task. Bench probes
        are disabled. Software-clock sink by default; never claim audible output.

config DISCORA_CD_PLAYER_FAULT_TEST
    bool "Enable single-use software player fault injection commands"
    depends on DISCORA_CD_PLAYER && !DISCORA_CD_PLAYER_I2S
    default n
    help
        Explicit test delay/test fail commands only while playing. Each can be
        armed once per MCU boot, not rearmed by stop or media changes. No fake
        USB/sense result is logged; this tests software shutdown, not hardware recovery.

config DISCORA_TRACK_BUTTONS
    bool "Enable previous/next track buttons on GPIO8/GPIO9"
    depends on DISCORA_CD_PLAYER
    default y
    help
        Normally-open switches from GPIO8 (previous) and GPIO9 (next) to GND.
        Internal pull-ups, 30 ms debounce, one action per press after release.
        Same behavior as UART prev/next: start the adjacent supported audio track,
        no wrap at disc boundaries. No actions without media or while faulted.
        Holding both buttons suppresses navigation until both are released.

config DISCORA_CD_PLAYER_VERIFY
    bool "Hash accepted and consumed CD PCM for single-track EOF verification"
    depends on DISCORA_CD_PLAYER
    default n
    help
        Diagnostic overhead under the queue mutex. Logs counts and SHA-256 only;
        no PCM is saved. Verifies the software queue, not audible I2S delivery.

config DISCORA_OLED
    bool "Show track and state on SH1106 128x64 OLED (GPIO10/11)"
    depends on DISCORA_CD_PLAYER
    default y
    help
        I2C SDA=GPIO10, SCL=GPIO11, 100 kHz. Requires a 3.3V SH1106 module
        with external pull-ups to 3.3V. Not an SSD1306 driver.
        A separate low-priority task refreshes changed screens every 200 ms.
        Missing display or bus errors disable the UI until reboot, not playback.

config DISCORA_OLED_ADDRESS
    hex "OLED 7-bit I2C address"
    depends on DISCORA_OLED
    range 0x3c 0x3d
    default 0x3c
    help
        Use the module's SA0 setting: 0x3c or 0x3d, not 0x78 or 0x7a.

config DISCORA_CD_PLAYER_I2S
    bool "Use I2S instead of the software-clock sink"
    depends on DISCORA_CD_PLAYER
    default n
    help
        Requires a verified DAC board and wiring. This mode is compile-tested
        until physical output and L/R channels are measured.

endmenu

menu "Discora audio diagnostic"

config DISCORA_AUDIO_DIAGNOSTIC
    bool "Run UART-controlled I2S test tones instead of the USB probe"
    default n
    help
        Standalone generated-tone diagnostic, not CD playback. Boot is stopped.
        Commands select left/right/stereo/silence and play/pause/stop/status.
        Disables the USB probe in this mode; do not mix optical bench results.

config DISCORA_DIAG_I2S_64FS
    bool "Use 32-bit slots (64fs BCLK) for diagnostic comparison"
    depends on DISCORA_AUDIO_DIAGNOSTIC
    default n
    help
        Keep 44.1 kHz PCM16 stereo and the existing test tones, but use
        32-bit slots and a 32-bit WS width: nominal BCLK 2.8224 MHz.
        This is an opt-in comparison, not an accepted DAC fault fix.
        CD playback and the default diagnostic retain 16-bit slots.

config DISCORA_DIAG_CLOCK_PROBE
    bool "Enable UART clocks command with GPIO pulse-counter readback"
    depends on DISCORA_AUDIO_DIAGNOSTIC
    default n
    help
        Count BCLK and LRCK rising edges at the MCU pads for about one second.
        Uses two PCNT units, leaves I2S running, and requires no extra wires.
        Does not verify DAC-end waveforms, data alignment or analog output.

config DISCORA_I2S_BCLK
    int "BCLK output GPIO"
    depends on DISCORA_AUDIO_DIAGNOSTIC || DISCORA_CD_PLAYER_I2S
    range 1 18
    default 4

config DISCORA_I2S_LRCK
    int "LRCK/WS output GPIO"
    depends on DISCORA_AUDIO_DIAGNOSTIC || DISCORA_CD_PLAYER_I2S
    range 1 18
    default 5

config DISCORA_I2S_DATA
    int "DAC DIN output GPIO"
    depends on DISCORA_AUDIO_DIAGNOSTIC || DISCORA_CD_PLAYER_I2S
    range 1 18
    default 6

endmenu
```
